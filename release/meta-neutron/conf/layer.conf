## release/meta-neutron/conf/layer.conf
```bitbake
# We have a conf and classes directory, append to BBPATH
BBPATH .= ":${LAYERDIR}"

# We have a recipes directory containing .bb and .bbappend files, add to BBFILES
BBFILES += "${LAYERDIR}/recipes*/*/*.bb \
            ${LAYERDIR}/recipes*/*/*.bbappend"

BBFILE_COLLECTIONS += "neutron"
BBFILE_PATTERN_neutron := "^${LAYERDIR}/"
BBFILE_PRIORITY_neutron = "10"

LAYERSERIES_COMPAT_neutron = "styhead walnascar"
LAYERDEPENDS_neutron = "core"
```

## release/meta-neutron/wic/sdimage-neutron.wks
```
# short-description: Create Neutron Pi SD card image
# long-description: Creates a partitioned SD card image for use with
# Neutron (on Raspberry Pi). Boot files are located in the first vfat partition.

part /boot --source bootimg-partition --ondisk mmcblk0 --fstype=vfat --label boot --active --align 4096 --size 100
part / --source rootfs --ondisk mmcblk0 --fstype=ext4 --label root --align 4096 --size 4096

# Create a data partition that can be use for file storage (non-rootfs, doesn't get wiped in a FW update)
part /data --ondisk mmcblk0 --fstype=ext4 --label data --align 4096 --size 4096
```
